## meta-frameMonitor/conf/layer.conf
```bitbake
# We have a conf and classes directory, add to BBPATH
BBPATH .= ":${LAYERDIR}"

# We have recipes-* directories, add to BBFILES
BBFILES += "${LAYERDIR}/recipes-*/*/*.bb \
            ${LAYERDIR}/recipes-*/*/*.bbappend"

BBFILE_COLLECTIONS += "meta-frameMonitor"
BBFILE_PATTERN_meta-frameMonitor = "^${LAYERDIR}/"
BBFILE_PRIORITY_meta-frameMonitor = "6"

LAYERDEPENDS_meta-frameMonitor = "core"
LAYERSERIES_COMPAT_meta-frameMonitor = "walnascar"
```

## meta-frameSaver/conf/layer.conf
```bitbake
# We have a conf and classes directory, add to BBPATH
BBPATH .= ":${LAYERDIR}"

# We have recipes-* directories, add to BBFILES
BBFILES += "${LAYERDIR}/recipes-*/*/*.bb \
            ${LAYERDIR}/recipes-*/*/*.bbappend"

BBFILE_COLLECTIONS += "meta-frameSaver"
BBFILE_PATTERN_meta-frameSaver = "^${LAYERDIR}/"
BBFILE_PRIORITY_meta-frameSaver = "6"

LAYERDEPENDS_meta-frameSaver = "core"
LAYERSERIES_COMPAT_meta-frameSaver = "walnascar"
```
